// SPDX-License-Identifier: (GPL-2.0+ OR X11)
#include "suniv-f1c200s-newboard-lg4573-timing.dts"

/* Timing-only comparison from Linux5.7 panel-simple.c COM43H4M85ULC.
 * Keep this board's RGB666 bus, polarity, wiring and panel initialization.
 */
&panel {
    panel-timing {
        clock-frequency = <25000000>;
        hfront-porch = <10>;
        hsync-len = <10>;
        hback-porch = <15>;
        vfront-porch = <3>;
        vsync-len = <3>;
        vback-porch = <3>;
    };
};
